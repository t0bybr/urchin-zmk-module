## boards/shields/urchin_tp/Kconfig.defconfig
```kconfig
# Copyright (c) 2022 Duccio Breschi
# SPDX-License-Identifier: MIT

if SHIELD_URCHIN_TP_RIGHT

config ZMK_KEYBOARD_NAME
    default "urchin TP"

config ZMK_SPLIT_ROLE_CENTRAL
    default y

endif

if SHIELD_URCHIN_TP_LEFT || SHIELD_URCHIN_TP_RIGHT
config ZMK_SPLIT
    default y
endif
```

## boards/shields/urchin_tp/Kconfig.shield
```kconfig
# Copyright (c) 2022 Duccio Breschi
# SPDX-License-Identifier: MIT

config SHIELD_URCHIN_TP_LEFT
    def_bool $(shields_list_contains,urchin_tp_left)

config SHIELD_URCHIN_TP_RIGHT
    def_bool $(shields_list_contains,urchin_tp_right)
```
